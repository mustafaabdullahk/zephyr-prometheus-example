## prj.conf
```kconfig
# Copyright (c) 2021 Nordic Semiconductor ASA
# SPDX-License-Identifier: Apache-2.0
#
# This file contains selected Kconfig options for the application.

CONFIG_SENSOR=y
CONFIG_BLINK=y

CONFIG_PROMETHEUS=y
CONFIG_POSIX_API=y

CONFIG_NETWORKING=y
CONFIG_NET_IPV4=y
CONFIG_NET_IPV6=n
CONFIG_NET_TCP=y
CONFIG_NET_UDP=y
CONFIG_NET_DHCPV4=y
CONFIG_NET_SOCKETS=y
CONFIG_NET_SOCKETS_POLL_MAX=32
CONFIG_POSIX_MAX_FDS=32
CONFIG_NET_MAX_CONN=10
CONFIG_NET_MAX_CONTEXTS=10
CONFIG_NET_CONFIG_SETTINGS=y
CONFIG_NET_CONNECTION_MANAGER=y
CONFIG_NET_LOG=y
CONFIG_INIT_STACKS=y

CONFIG_LOG=y
CONFIG_ISR_STACK_SIZE=2048
CONFIG_MAIN_STACK_SIZE=8192
CONFIG_IDLE_STACK_SIZE=1024

CONFIG_REQUIRES_FULL_LIBC=y
CONFIG_COMMON_LIBC_MALLOC_ARENA_SIZE=8194
```

## src/main.c
```c
/*
 * Copyright (c) 2021 Nordic Semiconductor ASA
 * SPDX-License-Identifier: Apache-2.0
 */

#include <zephyr/kernel.h>
#include <zephyr/drivers/sensor.h>
#include <zephyr/logging/log.h>

#include <app_version.h>

#include <prometheus/pm_exposer.h>
#include <prometheus/pm_collector.h>
#include <prometheus/pm_counter.h>
#include <prometheus/pm_gauge.h>
#include <prometheus/pm_histogram.h>
#include <prometheus/pm_summary.h>

#include <stdio.h>
#include <stdlib.h>
#include <string.h>

LOG_MODULE_REGISTER(main, CONFIG_APP_LOG_LEVEL);

#define PORT         8080
#define METRICS_PATH "/metrics"

struct {

	pm_collector_t *collector;

	pm_counter_t *counter;

} prom_context;

static void prometheus_exposer_thread(void)
{

	while (true) {
		LOG_INF(" >-- increase metrics value %ld", prom_context.counter->value);

		pm_counter_inc(prom_context.counter);

		k_sleep(K_SECONDS(1));
	}
}

K_THREAD_DEFINE(prom_exposer_id, 2048, prometheus_exposer_thread, NULL, NULL, NULL, 5, 0, 2000);

int main(void)
{
	printk("Zephyr Example Application %s\n", APP_VERSION_STRING);

	// Create a mock collector with different types of metrics
	prom_context.collector = pm_collector_create();

	pm_label_t labels[] = {{"label1", "value1"}, {"label2", "value2"}};
	prom_context.counter = pm_counter_create("test_counter", "Test counter", labels, 2);
	pm_counter_inc(prom_context.counter);

	pm_collector_register_metric(prom_context.collector, (pm_metric_t *)prom_context.counter);

	pm_exposer_start(PORT, METRICS_PATH, prom_context.collector);

	return 0;
}
```
